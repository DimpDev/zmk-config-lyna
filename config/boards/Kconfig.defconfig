## config/boards/Kconfig.defconfig
```kconfig
if SHIELD_LYNA_LEFT


config ZMK_KEYBOARD_NAME
    default "Lyna"

config ZMK_SPLIT_ROLE_CENTRAL
    default y

endif

if SHIELD_LYNA_LEFT || SHIELD_LYNA_RIGHT

config ZMK_SPLIT
    default y

endif
```

## config/boards/shields/lyna/Kconfig
```kconfig
config BT_DEVICE_NAME
    default ZMK_KEYBOARD_NAME

config EC11
    bool "Enable EC11 encoder"
    default y
    help
      Enable the EC11 encoder support for the encoder module.
DT_HAS_ALPS_EC11_ENABLED
    default y
```

## zmk-config-lyna/config/boards/shields/Kconfig.defconfig
```kconfig
if SHIELD_LYNA_LEFT


config ZMK_LYNA
    default "Lyna"

config ZMK_SPLIT_ROLE_CENTRAL
    default y

endif

if SHIELD_LYNA_LEFT || SHIELD_LYNA_RIGHT

config ZMK_SPLIT
    default y

endif
```

## zmk-config-lyna/config/boards/shields/Kconfig.shield
```kconfig
config LYNA_LEFT
    def_bool $(shields_list_contains,lyna_left)

config LYNA_RIGHT
    def_bool $(shields_list_contains,lyna_right)
```
